qcom,ocean-id1-batterydata {
	qcom, = <24>;
	/* #2711269_HTC_B2PZC100atl_3000mAh_averaged_MasterSlave_Jan23rd2017*/
	qcom,max-voltage-uv = <4400000>;
	qcom,nom-batt-capacity-mah = <3000>;
	qcom,batt-id-kohm = <22>;
	qcom,battery-beta = <4360>;
	qcom,battery-type = "ocean_id1";
	qcom,checksum = <0x747E>;
	qcom,gui-version = "PMI8998GUI - 2.0.0.54";

	qcom,fastchg-current-ma = <3000>;
	qcom,fg-cc-cv-threshold-mv = <4400>;
	qcom,fcc-mah = <3000>;

	htc,batt_id = <1>;
	htc,id_raw_min = <14001>;
	htc,id_raw_max = <33000>;

	qcom,fg-profile-data = [
		 64 1F B3 05
		 7C 0A 3E 06
		 5F 1D 8E 07
		 F6 0B 93 14
		 6D 18 E1 22
		 C0 45 66 52
		 56 00 00 00
		 0F 00 00 00
		 00 00 AA C3
		 F6 D5 00 9C
		 2C 00 08 00
		 86 00 47 07
		 5C 06 99 F3
		 C9 0D 9D 0A
		 FE 00 50 3A
		 21 06 09 20
		 27 00 14 00
		 D4 1C 3A EB
		 CF FA C5 07
		 E9 1C 6F 02
		 5D 0D 61 0A
		 B1 19 4D 22
		 42 3C 13 52
		 7D 00 00 00
		 13 00 00 00
		 00 00 D2 D5
		 72 CA 02 00
		 21 00 00 00
		 B1 F3 47 07
		 CE F4 14 EA
		 B3 ED BB 01
		 4D E2 53 1B
		 A8 33 CC FF
		 07 10 00 00
		 10 0C 66 46
		 21 00 40 00
		 8E 01 0A FA
		 FF 00 00 00
		 00 00 00 00
		 00 00 00 00
		 00 00 00 00
		 00 00 00 00
		 00 00 00 00
		 00 00 00 00
		 00 00 00 00
		 00 00 00 00
		 00 00 00 00
		 00 00 00 00
		 00 00 00 00
		 00 00 00 00
		 00 00 00 00
		 00 00 00 00
		 00 00 00 00
		 00 00 00 00
		 00 00 00 00
		 00 00 00 00
	];
};
