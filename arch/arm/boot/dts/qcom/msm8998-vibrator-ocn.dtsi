&pmi8998_haptics {
	status = "okay";
	compatible = "qcom,qpnp-haptic";
	reg = <0xc000 0x100>;
	interrupts = <0x3 0xc0 0x0>,
		     <0x3 0xc0 0x1>;
	interrupt-names = "sc-irq", "play-irq";
	qcom,actuator-type = "lra";
	qcom,play-mode = "direct";
	qcom,vmax-mv = <2828>;
	qcom,ilim-ma = <800>;
	qcom,wave-shape = "sine";
	qcom,wave-play-rate-us = <4255>;
	qcom,int-pwm-freq-khz = <505>;
	qcom,sc-deb-cycles = <8>;
	qcom,en-brake;
	qcom,brake-pattern = [03 03 00 00];
	qcom,use-play-irq;
	qcom,use-sc-irq;
	qcom,lra-high-z = "opt1";
	qcom,lra-auto-res-mode = "qwd";
	qcom,lra-res-cal-period = <4>;
};
