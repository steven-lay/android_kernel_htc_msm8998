/* Copyright (c) 2016, The Linux Foundation. All rights reserved.
 *
 * This program is free software; you can redistribute it and/or modify
 * it under the terms of the GNU General Public License version 2 and
 * only version 2 as published by the Free Software Foundation.
 *
 * This program is distributed in the hope that it will be useful,
 * but WITHOUT ANY WARRANTY; without even the implied warranty of
 * MERCHANTABILITY or FITNESS FOR A PARTICULAR PURPOSE.  See the
 * GNU General Public License for more details.
 */


/dts-v1/;

#include "msm8998-v2.1.dtsi"
#include "msm8998-htc_ocn.dtsi"
#include "msm8998-camera-sensor-ocn.dtsi"
#include "msm8998-audio-htc_ocn_xc.dtsi" /* HTC_AUD */

/ {
	model = "HTC Corporation. MSM8998 v2.1 OCN XC";
	qcom,msm-id = <436 0x20001>, <437 0x20001>, <438 0x20001>, <439 0x20001>, <440 0x20001>, <443 0x20001>;
	qcom,board-id = <2 0>;
};
