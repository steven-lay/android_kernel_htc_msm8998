## drivers/input/touchscreen/synaptics_dsx_htc/Kconfig
```kconfig
#
# Synaptics DSX touchscreen driver configuration
#
menuconfig TOUCHSCREEN_SYNAPTICS_DSX_HTC
	bool "Synaptics DSX touchscreen"
	default n
	help
	  Say Y here if you have a Synaptics DSX touchscreen connected
	  to your system.

	  If unsure, say N.

if TOUCHSCREEN_SYNAPTICS_DSX_HTC

choice
	default TOUCHSCREEN_SYNAPTICS_DSX_I2C_HTC
	prompt "Synaptics DSX bus interface"
config TOUCHSCREEN_SYNAPTICS_DSX_I2C_HTC
	bool "RMI over I2C"
	depends on I2C
config TOUCHSCREEN_SYNAPTICS_DSX_SPI_HTC
	bool "RMI over SPI"
	depends on SPI_MASTER
config TOUCHSCREEN_SYNAPTICS_DSX_RMI_HID_I2C_HTC
	bool "HID over I2C"
	depends on I2C
endchoice

config TOUCHSCREEN_SYNAPTICS_DSX_CORE_HTC
	tristate "Synaptics DSX core driver module"
	depends on I2C || SPI_MASTER
	help
	  Say Y here to enable basic touch reporting functionality.

	  If unsure, say N.

	  To compile this driver as a module, choose M here: the
	  module will be called synaptics_dsx_core.

config TOUCHSCREEN_SYNAPTICS_DSX_RMI_DEV_HTC
	tristate "Synaptics DSX RMI device module"
	depends on TOUCHSCREEN_SYNAPTICS_DSX_CORE_HTC
	help
	  Say Y here to enable support for direct RMI register access.

	  If unsure, say N.

	  To compile this driver as a module, choose M here: the
	  module will be called synaptics_dsx_rmi_dev.

config TOUCHSCREEN_SYNAPTICS_DSX_FW_UPDATE_HTC
	tristate "Synaptics DSX firmware update module"
	depends on TOUCHSCREEN_SYNAPTICS_DSX_CORE_HTC
	help
	  Say Y here to enable support for doing firmware update.

	  If unsure, say N.

	  To compile this driver as a module, choose M here: the
	  module will be called synaptics_dsx_fw_update.

config TOUCHSCREEN_SYNAPTICS_DSX_TEST_REPORTING_HTC
	tristate "Synaptics DSX test reporting module"
	depends on TOUCHSCREEN_SYNAPTICS_DSX_CORE_HTC
	help
	  Say Y here to enable support for retrieving production test reports.

	  If unsure, say N.

	  To compile this driver as a module, choose M here: the
	  module will be called synaptics_dsx_test_reporting.

config TOUCHSCREEN_SYNAPTICS_DSX_PROXIMITY_HTC
	tristate "Synaptics DSX proximity module"
	depends on TOUCHSCREEN_SYNAPTICS_DSX_CORE_HTC
	help
	  Say Y here to enable support for proximity functionality.

	  If unsure, say N.

	  To compile this driver as a module, choose M here: the
	  module will be called synaptics_dsx_proximity.

config TOUCHSCREEN_SYNAPTICS_DSX_ACTIVE_PEN_HTC
	tristate "Synaptics DSX active pen module"
	depends on TOUCHSCREEN_SYNAPTICS_DSX_CORE_HTC
	help
	  Say Y here to enable support for active pen functionality.

	  If unsure, say N.

	  To compile this driver as a module, choose M here: the
	  module will be called synaptics_dsx_active_pen.

config TOUCHSCREEN_SYNAPTICS_DSX_GESTURE_HTC
	tristate "Synaptics DSX user defined gesture module"
	depends on TOUCHSCREEN_SYNAPTICS_DSX_CORE_HTC
	help
	  Say Y here to enable support for user defined gesture functionality.

	  If unsure, say N.

	  To compile this driver as a module, choose M here: the
	  module will be called synaptics_dsx_gesture.

config TOUCHSCREEN_SYNAPTICS_DSX_VIDEO_HTC
	tristate "Synaptics DSX video module"
	depends on TOUCHSCREEN_SYNAPTICS_DSX_CORE_HTC
	help
	  Say Y here to enable support for video communication functionality.

	  If unsure, say N.

	  To compile this driver as a module, choose M here: the
	  module will be called synaptics_dsx_video.

config TOUCHSCREEN_SYNAPTICS_DSX_DEBUG_HTC
	tristate "Synaptics DSX debug module"
	depends on TOUCHSCREEN_SYNAPTICS_DSX_CORE_HTC
	help
	  Say Y here to enable support for firmware debug functionality.

	  If unsure, say N.

	  To compile this driver as a module, choose M here: the
	  module will be called synaptics_dsx_debug.

config TOUCHSCREEN_SYNAPTICS_DSX_ESD_DETECTION
	bool "Synaptics DSX ESD detection"
	depends on TOUCHSCREEN_SYNAPTICS_DSX_CORE_HTC
	default n
	help
	  Say Y to enable support for touch ESD recovery callback.

	  If unsure, say N.

endif
```

## drivers/misc/fpr_FingerprintCard/Kconfig
```kconfig
#
# FingerprintCard fingerprint driver
#
menu "FingerprintCard fingerprint driver"
config FPR_FPC
       default n
       tristate "FPC_BTP fingerprint sensor support"
       depends on SPI_MASTER

config FPC_HTC_DISABLE_CHARGING
       tristate "HTC FPC disable charging while capturing image during enroll/verify"
       depends on FPR_FPC
       default n

config FPC_HTC_ENABLE_DBG
       tristate "HTC FPC enable dbg log"
       depends on FPR_FPC
       default y

endmenu
```

## drivers/misc/goodix_fp/Kconfig
```kconfig
#
# Fingerprint driver configuration 
#
menu "Goodix fingerprint SPI driver"
config GOODIX_FP
       default n
       tristate "Goodix BTP fingerprint sensor support"
       depends on SPI_MASTER

config HTC_DISABLE_CHARGING
       default n
       tristate "HTC FP disable charging while capturing image during enroll/verify"
       depends on GOODIX_FP

config HTC_PCN_HAL_FOOTPRINT_CMD
       default n
       tristate "HTC sync time at kernel from HAL layer!"
       depends on GOODIX_FP

endmenu
```

## drivers/staging/nanohub/Kconfig
```kconfig
config NANOHUB
	tristate "Nanohub"
	default N
	help
	  Enable support for the nanohub sensorhub driver.

	  This driver supports the android nanohub sensorhub.

	  If in doubt, say N here.

if NANOHUB

config NANOHUB_SPI
	bool "Nanohub SPI"
	default Y
	help
	  Enable nanohub SPI support.

	  Either this or NANOHUB_I2C should be selected.

	  If in doubt, say Y here.

config NANOHUB_I2C
	bool "Nanohub I2C"
	default N
	help
	  Enable nanohub I2C support.

	  Either this or NANOHUB_SPI should be selected.

	  If in doubt, say N here.

config NANOHUB_STM32L4
	bool "Nanohub STM32L4 series"
	default N
	help
	  Use STM32L4 series as nanohub

config NANOHUB_CONTEXTHUB_HAL
	bool "Nanohub ContextHub HAL"
	default N
	help
	  Enable contextHub HAL support.

config NANOHUB_TP_SWITCH
	bool "TP switch pin status synchronization"
	default n
	help
	  TP switch pin status synchronization

config NANOHUB_SECOND_DISP
	bool "Second Disp"
	default n
	depends on NANOHUB_TP_SWITCH
	help
	  Second Disp

config NANOHUB_AOD
	bool "Always on display"
	default n
	depends on NANOHUB_TP_SWITCH
	help
	  Always on display mode

config NANOHUB_EDGE
	bool "Edge sensor"
	default n
	help
	  Edge sensor

config NANOHUB_HTC_SENSTYPE_OFFSET
	bool "HTC sensor type offset"
	default n
	help
	  HTC sensor type offset

config NANOHUB_HTC_LOG
	bool "Trigger dump htc log"
	default n
	help
	  Trigger dump htc log

config NANOHUB_FLASH_GPIO_CONTROL
	bool "Flash gpio control"
	default n
	help
	  Flash gpio control

config NANOHUB_FLASH_STATUS_CHECK
	bool "Flash status check"
	default n
	help
	  Flash status check

config NANOHUB_FLASH_RETRY
	bool "Flash firmware retry"
	default n
	help
	  Flash firmware retry

config NANOHUB_KTHREAD_RUN_PROBE_END
	bool "Kthread_run at probe end"
	default n
	help
	  Kthread_run at probe end

endif # NANOHUB
```

## drivers/usb/tps61099/Kconfig
```kconfig
#
# USB device configuration
#

config TPS61099
	bool "TPS61099 external power source"
	default n
	help
	  Say Y here to enable the TPS61099 external power source
```

## drivers/usb/tusb1044/Kconfig
```kconfig
#
# USB device configuration
#

config TUSB1044
	bool "TUSB1044 usb3 re-drive"
	default n
	help
	  Say Y here to enable the TUSB1044 usb3.0 re-drive
```
