## Documentation/devicetree/bindings/leds/backlight/lp855x.txt
```
lp855x bindings

Required properties:
  - compatible: "ti,lp8550", "ti,lp8551", "ti,lp8552", "ti,lp8553",
                "ti,lp8555", "ti,lp8556", "ti,lp8557"
  - reg: I2C slave address (u8)
  - dev-ctrl: Value of DEVICE CONTROL register (u8). It depends on the device.

Optional properties:
  - bl-name: Backlight device name (string)
  - init-brt: Initial value of backlight brightness (u8)
  - pwm-period: PWM period value. Set only PWM input mode used (u32)
  - rom-addr: Register address of ROM area to be updated (u8)
  - rom-val: Register value to be updated (u8)
  - power-supply: Regulator which controls the 3V rail
  - torch-brt: torch brightness when flash mode use
  - enable-gpios: bl enable gpio pin
  - normal-power-on-cmds: bl normal power on commands
  - aod-power-on-cmds: bl aod power on commands
  - aod-disable-cmds: bl aod disable commands
  - aod-enable-cmds: bl aod enable commands

AOD BL control is decided by FB event, below list fb status change to BL control action.
1.FB_BLANK_POWERDOWN : disable gpio
2.FB_BLANK_POWERDOWN --> FB_BLANK_UNBLANK : enable gpio then run normal-power-on-cmds
3.FB_BLANK_POWERDOWN --> FB_BLANK_NORMAL : enable gpio then run aod-power-on-cmds
4.FB_BLANK_NORMAL --> FB_BLANK_UNBLANK : run aod-disable-cmds
5.FB_BLANK_UNBLANK --> FB_BLANK_NORMAL : run aod-enable-cmds

Example:

	/* LP8555 */
	backlight@2c {
		compatible = "ti,lp8555";
		reg = <0x2c>;

		dev-ctrl = /bits/ 8 <0x00>;
		pwm-period = <10000>;

		/* 4V OV, 4 output LED0 string enabled */
		rom_14h {
			rom-addr = /bits/ 8 <0x14>;
			rom-val = /bits/ 8 <0xcf>;
		};

		/* Heavy smoothing, 24ms ramp time step */
		rom_15h {
			rom-addr = /bits/ 8 <0x15>;
			rom-val = /bits/ 8 <0xc7>;
		};

		/* 4 output LED1 string enabled */
		rom_19h {
			rom-addr = /bits/ 8 <0x19>;
			rom-val = /bits/ 8 <0x0f>;
		};
	};

	/* LP8556 */
	backlight@2c {
		compatible = "ti,lp8556";
		reg = <0x2c>;

		bl-name = "lcd-bl";
		dev-ctrl = /bits/ 8 <0x85>;
		init-brt = /bits/ 8 <0x10>;
		torch-brt = <2048>;
		enable-gpios = <&tlmm 124 0>;
		normal-power-on-cmds = [
			01 80
			00 FF
			16 3f
			A1 9F
			A2 20
			A3 46
			A9 A0
			AE 01
			A8 24
			01 87
			];
		aod-power-on-cmds = [
			01 80
			00 FF
			16 0C
			A1 9F
			A2 20
			A3 46
			A9 A0
			AE 01
			A8 24
			01 87
			];
		aod-disable-cmds = [
			16 3f
			];
		aod-enable-cmds = [
			16 0C
			];
	};

	/* LP8557 */
	backlight@2c {
		compatible = "ti,lp8557";
		reg = <0x2c>;
		power-supply = <&backlight_vdd>;

		dev-ctrl = /bits/ 8 <0x41>;
		init-brt = /bits/ 8 <0x0a>;

		/* 4V OV, 4 output LED string enabled */
		rom_14h {
			rom-addr = /bits/ 8 <0x14>;
			rom-val = /bits/ 8 <0xcf>;
		};
	};
```

## Documentation/devicetree/bindings/leds/backlight/ti-lmu-backlight.txt
```
TI LMU backlight device tree bindings

Required property:
  - compatible: Should be one of:
                "ti,lm3532-backlight"
                "ti,lm36272-backlight"
                "ti,lm36274-backlight"
                "ti,lm3631-backlight"
                "ti,lm3632-backlight"
                "ti,lm3633-backlight"
                "ti,lm3695-backlight"
                "ti,lm3697-backlight"

Optional properties:
  There are two backlight control mode. One is I2C, the other is PWM mode.
  Following properties are only specified in PWM mode.
  Please note that LMU backlight device can have only one PWM channel.

  - pwms: OF device-tree PWM specification.
  - pwm-names: a list of names for the PWM devices specified in the "pwms"
               property.

  For the PWM user nodes, please refer to [1].

Child nodes:
  LMU backlight is represented as sub-nodes of the TI LMU device [2].
  So, LMU backlight should have more than one backlight child node.
  Each node exactly matches with backlight control bank configuration.
  Maximum numbers of child nodes depend on the device.
  1 = LM36272, LM36274, LM3631, LM3632, LM3695
  2 = LM3633, LM3697
  3 = LM3532

  Required property of a child node:
  - led-sources: List of enabled channels from 0 to 4.
                 Please refer to LED binding [3].
                 For output channels, please refer to the datasheets [4].

  Optional properties of a child node:
  - label: Backlight channel identification.
           Please refer to LED binding [3].
  - default-brightness-level: Backlight initial brightness value.
                              Type is <u32>. It is set as soon as backlight
                              device is created.
                              0 ~ 2047 = LM36272, LM36274, LM3631, LM3632,
                                         LM3633, LM3695 and LM3697
                              0 ~ 255  = LM3532
  - ramp-up-msec, ramp-down-msec: Light dimming effect properties.
                                  Type is <u32>. Unit is millisecond.
                                  0 ~ 65 msec    = LM3532
                                  0 ~ 4000 msec  = LM3631
                                  0 ~ 16000 msec = LM3633 and LM3697
  - pwm-period: PWM period. Only valid in PWM brightness mode.
                Type is <u32>. If this property is missing, then control
                mode is set to I2C by default.

  - torch-brt: torch brightness when flash mode use

Examples: Please refer to ti-lmu dt-bindings. [2].

[1] ../pwm/pwm.txt
[2] ../mfd/ti-lmu.txt
[3] ../leds/common.txt
[4] LM3532: http://www.ti.com/product/LM3532/datasheet
    LM3631: http://www.ti.com/product/LM3631/datasheet
    LM3632: http://www.ti.com/product/LM3632A/datasheet
    LM3633: http://www.ti.com/product/LM3633/datasheet
    LM3695: Datasheet is not opened yet, but only two strings are used.
    LM3697: http://www.ti.com/product/LM3697/datasheet
```

## Documentation/devicetree/bindings/regulator/lm363x-regulator.txt
```
TI LMU LM363x regulator device tree bindings

LM363x regulator driver supports LM36272, LM36274, LM3631 and LM3632.
LM3631 has five regulators and LM36272 and LM3632 support three regulators.

Required property:
  - compatible: "ti,lm363x-regulator"

Optional properties:
  LM3632 has external enable pins for two LDOs.
  - ti,lcm-en1-gpios: A GPIO specifier for Vpos control pin.
  - ti,lcm-en2-gpios: A GPIO specifier for Vneg control pin.

  LM36272 and LM36274 has a specific property for bias mode configuration.
  - display-bias-mode: Supported values are
                       "default", "auto", "wake1", "wake2".

Child nodes:
  LM3631
  - vboost
  - vcont
  - voref
  - vpos
  - vneg

  LM36272, LM36274 and LM3632
  - vboost
  - vpos
  - vneg

  Optional properties of a child node:
  Each sub-node should contain the constraints and initialization.
  Please refer to [1].

Examples: Please refer to ti-lmu dt-bindings [2].

[1] ../regulator/regulator.txt
[2] ../mfd/ti-lmu.txt
```

## arch/arm64/Kconfig.htc
```kconfig
comment "HTC Debugging Features"
menuconfig HTC_DEBUG
  bool "HTC Debugging Feature Switch"
  default n
  help
    Enable collection of debug features.
    This feature is enabled in defconfig.

config HTC_LOGLEVEL
  bool "HTC log level"
  default y
  help
    Say yes to enable get log level.

config HTC_DEBUG_SSR
	bool "HTC style subsys restart debug features"
	default n
	depends on HTC_DEBUG && MSM_SUBSYSTEM_RESTART
	help
	  Say Y here if you want the HTC style subsys restart debug features

config HTC_DEBUG_RTB
	default n
	depends on HTC_DEBUG && QCOM_RTB
	bool "HTC style rtb debug features"
	help
	  Say Y here if you want the HTC style rtb debug features

config HTC_DEBUG_WORKQUEUE
	bool "HTC style workqueue debug features"
	depends on HTC_DEBUG
	help
	  Say Y here if you want the HTC style workqueue debug features

config HTC_DEBUG_WATCHDOG
	bool "HTC style watchdog debug features"
	depends on HTC_DEBUG && QCOM_WATCHDOG_V2
	help
	  Say Y here if you want the HTC style watchdog debug features

comment "HTC features"
menuconfig HTC_FEATURES
	bool "HTC Implement Features"
	default n
	help
	  Enable collection of HTC features.
	  This feature is enabled in defconfig.

config HTC_FEATURES_SSR
	bool "HTC style ssr features"
	depends on HTC_FEATURES && MSM_SUBSYSTEM_RESTART
	default n
	help
	  Say Y here if you want the HTC style ssr features

config HTC_FEATURES_SSR_MODEM_ENABLE
	bool "HTC style modem ssr features"
	depends on HTC_FEATURES_SSR
	default n
	help
	  Say Y here if you want the HTC style for modem ssr features

config HTC_FEATURES_SSR_LPASS_ENABLE
	bool "HTC style lpass ssr features"
	depends on HTC_FEATURES_SSR
	default n
	help
	  Say Y here if you want the HTC style for lpass ssr features

config HTC_FEATURES_SSR_SLPI_ENABLE
	bool "HTC style slpi ssr features"
	depends on HTC_FEATURES_SSR
	default n
	help
	  Say Y here if you want the HTC style for slpi ssr features

config HTC_FEATURES_SSR_WCNSS_ENABLE
	bool "HTC style wcnss ssr features"
	depends on HTC_FEATURES_SSR
	default n
	help
	  Say Y here if you want the HTC style for wcnss ssr features

config HTC_FD_MONITOR
	bool "fd operation monitor mechanism"
	default n

config ENABLE_VENDOR_IMAGE
	bool "enable vendor image or not"
	default n

config LMK_ZYGOTE_PROTECT
	bool "LMK zygote protect"
	default n
	help
```

## drivers/firmware/qcom/Kconfig
```kconfig
config MSM_TZ_LOG
        tristate "MSM Trust Zone (TZ) Log Driver"
        depends on DEBUG_FS
        help
          This option enables a driver with a debugfs interface for messages
          produced by the Secure code (Trust zone). These messages provide
          diagnostic information about TZ operation.

config HTC_TZ_LOG
       tristate "HTC MSM Trust Zone (TZ) Log"
       depends on MSM_TZ_LOG
       default y
```

## drivers/htc_debug/stability/Kconfig
```kconfig
config HTC_DEBUG_RESTART_TIMER
	bool "add a timer in restart notifier chain"
	default y
	depends on HTC_DEBUG

config HTC_REBOOT_BLOCK
	bool "Store reboot reason / msg ...etc. in IMEM or storage"
	default n
	help
	  Say Y here if you want the HTC Reboot Block feature

config HTC_HELPER_FUNCTIONS
	bool "HTC helper functions"
	depends on HTC_DEBUG
	default n
	help
	  Extract debug flag from kernel cmdline and define read-only
	  functions to global kernel space

config HTC_DEBUG_PAGE_ENTRIES_NR
	int
	default 4

config HTC_NC_GPIO_PIN_SETTING
	bool "HTC style nc pin setting features"
	default n
	help
	  Say Y here if you want the HTC style nc pin setting features
```

## drivers/htc_loglevel/Kconfig
```kconfig
config HTC_LOGLEVEL
    bool "HTC log level"
    default y
    help
      Say yes to enable get log level.
```

## drivers/htc_ril/Kconfig
```kconfig
config HTC_GARBAGE_FILTER
	tristate "HTC_GARBAGE_FILTER"
	default n
	depends on MSM_SMD
	---help---
	  HTC Garbage Filter of TCP
```

## drivers/i2c/chips/Kconfig
```kconfig
#
# Miscellaneous I2C chip drivers configuration
#
# *** DEPRECATED! Do not add new entries! See Makefile ***
#

menu "Miscellaneous I2C Chip support"

config SENSORS_NFC_CXD224X
        tristate "CXD224X NFC sensor support"
        depends on I2C=y
        help
          CXD224X NFC Driver implemented.

endmenu
```

## drivers/input/edge_xr15510/Kconfig
```kconfig
#
# Exar edge sensor driver configuration
#

config EDGE_XR15510
	tristate "exar edge sensor driver module"
	depends on I2C=y
	help
	  Say Y here to enable.
```

## drivers/input/touchscreen/cyttsp5/Kconfig
```kconfig
config TOUCHSCREEN_CYPRESS_CYTTSP5
	bool "Parade TrueTouch Gen5 Touchscreen Driver"
	default n

config TOUCHSCREEN_CYPRESS_CYTTSP5_DEVICETREE_SUPPORT
	bool "Enable Device Tree support"
	default n

config TOUCHSCREEN_CYPRESS_CYTTSP5_DEBUG
	bool "Enable debug output"
	default n

config TOUCHSCREEN_CYPRESS_CYTTSP5_VDEBUG
	bool "Enable verbose debug output"
	default n

config TOUCHSCREEN_CYPRESS_CYTTSP5_I2C
	bool "Parade TrueTouch Gen5 I2C"
 	default n 	

config TOUCHSCREEN_CYPRESS_CYTTSP5_MT_A
	bool "Protocol A"
	default n 

config TOUCHSCREEN_CYPRESS_CYTTSP5_MT_B
	bool "Protocol B"
 	default n 

config TOUCHSCREEN_CYPRESS_CYTTSP5_BUTTON
	bool "Parade TrueTouch Gen5 MultiTouch CapSense Button"
  default n 

config TOUCHSCREEN_CYPRESS_CYTTSP5_PROXIMITY
	bool "Parade TrueTouch Gen5 Proximity"
	default n 

config TOUCHSCREEN_CYPRESS_CYTTSP5_DEVICE_ACCESS
	bool "Parade TrueTouch Gen5 MultiTouch Device Access"
	default n 

config TOUCHSCREEN_CYPRESS_CYTTSP5_DEVICE_ACCESS_API
	bool "Enable Device Access kernel API"
	default n 

config TOUCHSCREEN_CYPRESS_CYTTSP5_TEST_DEVICE_ACCESS_API
	bool "Simple Test module for Device Access kernel API"
	default n 

config TOUCHSCREEN_CYPRESS_CYTTSP5_LOADER
	bool "Parade TrueTouch Gen5 MultiTouch Loader"
	default n 

config TOUCHSCREEN_CYPRESS_CYTTSP5_PLATFORM_FW_UPGRADE
	bool "FW upgrade from header file"
	default n 

config TOUCHSCREEN_CYPRESS_CYTTSP5_BINARY_FW_UPGRADE
	bool "FW upgrade from binary file"
	default n 

config TOUCHSCREEN_CYPRESS_CYTTSP5_PLATFORM_TTCONFIG_UPGRADE
	bool "TT Configuration upgrade from header file"
	default n 
	
config TOUCHSCREEN_CYPRESS_CYTTSP5_MANUAL_TTCONFIG_UPGRADE
	bool "TT Configuration upgrade via SysFs"
	default n 

config TOUCHSCREEN_CYPRESS_CYTTSP5_DEBUG_MDL
	bool "Parade TrueTouch Gen5 MultiTouch Debug Module"
	default n 
```
